// Copyright 2017 Emilie Gillet.
//
// Author: Emilie Gillet (emilie.o.gillet@gmail.com)
//
// Permission is hereby granted, free of charge, to any person obtaining a copy
// of this software and associated documentation files (the "Software"), to deal
// in the Software without restriction, including without limitation the rights
// to use, copy, modify, merge, publish, distribute, sublicense, and/or sell
// copies of the Software, and to permit persons to whom the Software is
// furnished to do so, subject to the following conditions:
// 
// The above copyright notice and this permission notice shall be included in
// all copies or substantial portions of the Software.
// 
// THE SOFTWARE IS PROVIDED "AS IS", WITHOUT WARRANTY OF ANY KIND, EXPRESS OR
// IMPLIED, INCLUDING BUT NOT LIMITED TO THE WARRANTIES OF MERCHANTABILITY,
// FITNESS FOR A PARTICULAR PURPOSE AND NONINFRINGEMENT. IN NO EVENT SHALL THE
// AUTHORS OR COPYRIGHT HOLDERS BE LIABLE FOR ANY CLAIM, DAMAGES OR OTHER
// LIABILITY, WHETHER IN AN ACTION OF CONTRACT, TORT OR OTHERWISE, ARISING FROM,
// OUT OF OR IN CONNECTION WITH THE SOFTWARE OR THE USE OR OTHER DEALINGS IN
// THE SOFTWARE.
// 
// See http://creativecommons.org/licenses/MIT/ for more information.
//
// -----------------------------------------------------------------------------
//
// Lightweight DAC driver used for the firmware update procedure.
// Initializes the I2S port as SPI, and relies on a timer for clock generation.

#include "waves/drivers/lcd.h"
#include "waves/Display.h"

namespace waves {

uint8_t pic1[]=
{/*--  µ÷ÈëÁËÒ»·ùÍ¼Ïñ£ºD:\liu\ÏÔÊ¾Í¼Æ¬\12864LOGO.bmp  --*/
/*--  ¿í¶Èx¸ß¶È=128x64  --*/
0xFF,0x01,0x01,0x01,0x01,0x01,0x01,0x01,0x01,0x01,0x01,0x01,0x01,0x01,0x01,0x01,
0x01,0x01,0x01,0xC1,0xE1,0xF1,0xFD,0xFF,0xFF,0xFD,0x01,0x61,0xF1,0xE1,0xE1,0xE1,
0xE1,0xC1,0xC1,0xC1,0xC1,0xC1,0x81,0x81,0x81,0x81,0x01,0x01,0x01,0x01,0x01,0x01,
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0x80,0x80,0x80,0x80,0x80,0x80,0x80,0x80,0x80,0x80,0x80,0x80,0x80,0x80,0x80,0xFF

};

uint8_t pic[]=
{/*--  µ÷ÈëÁËÒ»·ùÍ¼Ïñ£ºD:\²úÆ·ÎÄ¼þ\ÏÔÊ¾Í¼Æ¬\ERC12864-4 Series.bmp  --*/
/*--  ¿í¶Èx¸ß¶È=128x64  --*/
0xFF,0x01,0x01,0xF9,0x49,0x49,0x49,0x49,0x01,0xC1,0xB1,0x89,0xB1,0xC1,0x01,0x31,
0x49,0x49,0x91,0x01,0x09,0x09,0xF9,0x09,0x09,0x01,0xF9,0x49,0x49,0xC9,0x31,0x01,
0x01,0xF9,0x01,0x01,0x31,0x49,0x49,0x91,0x01,0x01,0xF9,0x01,0x01,0xF9,0x31,0x41,
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0xA2,0x9C,0x80,0x90,0xA0,0xA2,0xA2,0x9D,0x80,0xA0,0xB0,0xA8,0xA4,0xA3,0x80,0xFF


};

/* static */
LCD* LCD::instance_;

void LCD::Init() {
  instance_ = this;


  RCC_AHB1PeriphClockCmd(RCC_AHB1Periph_GPIOA, ENABLE);
  RCC_AHB1PeriphClockCmd(RCC_AHB1Periph_GPIOB, ENABLE);
  RCC_AHB1PeriphClockCmd(RCC_AHB1Periph_GPIOC, ENABLE);
  RCC_AHB1PeriphClockCmd(RCC_AHB1Periph_GPIOD, ENABLE);
  RCC_APB1PeriphClockCmd(RCC_APB1Periph_SPI3, ENABLE);
  RCC_AHB1PeriphClockCmd(RCC_AHB1Periph_DMA1, ENABLE);
  
  // DMA_Cmd(DMA1_Stream5, DISABLE);
  // DMA_DeInit(DMA1_Stream5);

  // Initialize LCD NSS pin.
  GPIO_InitTypeDef gpio_init;
  gpio_init.GPIO_Mode = GPIO_Mode_OUT;
  gpio_init.GPIO_OType = GPIO_OType_PP;
  gpio_init.GPIO_Speed = GPIO_Speed_2MHz;
  gpio_init.GPIO_PuPd = GPIO_PuPd_NOPULL;
  gpio_init.GPIO_Pin = GPIO_Pin_15;
  GPIO_Init(GPIOA, &gpio_init);

  // Initialize CMD NSS pin.
  gpio_init.GPIO_Mode = GPIO_Mode_OUT;
  gpio_init.GPIO_OType = GPIO_OType_PP;
  gpio_init.GPIO_Speed = GPIO_Speed_2MHz;
  gpio_init.GPIO_PuPd = GPIO_PuPd_NOPULL;
  gpio_init.GPIO_Pin = GPIO_Pin_2;
  GPIO_Init(GPIOD, &gpio_init);

  // miso - NO MASTER IN
  // gpio_init.GPIO_Mode = GPIO_Mode_AF;
  // gpio_init.GPIO_OType = GPIO_OType_PP;
  // gpio_init.GPIO_Speed = GPIO_Speed_50MHz;
  // gpio_init.GPIO_PuPd = GPIO_PuPd_NOPULL;
  // gpio_init.GPIO_Pin = eeprom[EEPROM_MISO].pin;
  // GPIO_Init(eeprom[EEPROM_MISO].gpio, &gpio_init);

  // RESET
  gpio_init.GPIO_Mode = GPIO_Mode_OUT;
  gpio_init.GPIO_OType = GPIO_OType_PP;
  gpio_init.GPIO_Speed = GPIO_Speed_2MHz;
  gpio_init.GPIO_PuPd = GPIO_PuPd_NOPULL;
  gpio_init.GPIO_Pin = GPIO_Pin_11;
  GPIO_Init(GPIOC, &gpio_init);

  // mosi
  // gpio_init.GPIO_Mode = GPIO_Mode_OUT;
  // gpio_init.GPIO_OType = GPIO_OType_PP;
  // gpio_init.GPIO_Speed = GPIO_Speed_2MHz;
  // gpio_init.GPIO_PuPd = GPIO_PuPd_NOPULL;
  // gpio_init.GPIO_Pin = GPIO_Pin_12;
  // GPIO_Init(GPIOC, &gpio_init);

  // clock
  // gpio_init.GPIO_Mode = GPIO_Mode_OUT;
  // gpio_init.GPIO_OType = GPIO_OType_PP;
  // gpio_init.GPIO_Speed = GPIO_Speed_2MHz;
  // gpio_init.GPIO_PuPd = GPIO_PuPd_NOPULL;
  // gpio_init.GPIO_Pin = GPIO_Pin_10;
  // GPIO_Init(GPIOC, &gpio_init);


  // mosi
  gpio_init.GPIO_Mode = GPIO_Mode_AF;
  gpio_init.GPIO_OType = GPIO_OType_PP;
  gpio_init.GPIO_Speed = GPIO_Speed_2MHz;
  gpio_init.GPIO_PuPd = GPIO_PuPd_NOPULL;
  gpio_init.GPIO_Pin = GPIO_Pin_12;
  GPIO_Init(GPIOC, &gpio_init);

  // // clock
  gpio_init.GPIO_Mode = GPIO_Mode_AF;
  gpio_init.GPIO_OType = GPIO_OType_PP;
  gpio_init.GPIO_Speed = GPIO_Speed_2MHz;
  gpio_init.GPIO_PuPd = GPIO_PuPd_NOPULL;
  gpio_init.GPIO_Pin = GPIO_Pin_10;
  GPIO_Init(GPIOC, &gpio_init);
  
  GPIO_PinAFConfig(GPIOC, GPIO_PinSource10, GPIO_AF_SPI3);
  GPIO_PinAFConfig(GPIOC, GPIO_PinSource12, GPIO_AF_SPI3);

  HIGH(LCD_SS);
  HIGH(LCD_CMD);
  HIGH(LCD_RESET);
  // // Initialize SPI.
  SPI_InitTypeDef spi_init;
  spi_init.SPI_Direction = SPI_Direction_2Lines_FullDuplex;
  spi_init.SPI_Mode = SPI_Mode_Master;
  spi_init.SPI_DataSize = SPI_DataSize_8b;
  spi_init.SPI_CPOL = SPI_CPOL_Low;
  spi_init.SPI_CPHA = SPI_CPHA_1Edge;
  spi_init.SPI_NSS = SPI_NSS_Soft;
  spi_init.SPI_BaudRatePrescaler = SPI_BaudRatePrescaler_4;
  spi_init.SPI_FirstBit = SPI_FirstBit_MSB;
  spi_init.SPI_CRCPolynomial = 7;
  SPI_Init(SPI3, &spi_init);

  SPI_Cmd(SPI3, ENABLE);


  // DMA_InitTypeDef dma_init;

  // // SPI TX
  // dma_init.DMA_Channel = DMA_Channel_0;
  // dma_init.DMA_PeripheralBaseAddr = (uint32_t)&(SPI3->DR);
  // dma_init.DMA_Memory0BaseAddr = (uint32_t)(lcd_buffer[0]);
  // dma_init.DMA_DIR = DMA_DIR_MemoryToPeripheral;
  // dma_init.DMA_BufferSize = 0;
  // dma_init.DMA_PeripheralInc = DMA_PeripheralInc_Disable;
  // dma_init.DMA_MemoryInc = DMA_MemoryInc_Enable;
  // dma_init.DMA_PeripheralDataSize = DMA_PeripheralDataSize_Byte;
  // dma_init.DMA_MemoryDataSize = DMA_MemoryDataSize_Byte;
  // dma_init.DMA_Mode = DMA_Mode_Normal;
  // dma_init.DMA_Priority = DMA_Priority_High;
  // dma_init.DMA_FIFOMode = DMA_FIFOMode_Disable;
  // dma_init.DMA_FIFOThreshold = DMA_FIFOThreshold_1QuarterFull;
  // dma_init.DMA_MemoryBurst = DMA_MemoryBurst_Single;
  // dma_init.DMA_PeripheralBurst = DMA_PeripheralBurst_Single;
  // DMA_Init(DMA1_Stream5, &dma_init);

  // DMA_ITConfig(DMA1_Stream5, DMA_IT_TC, ENABLE);

  // // SPI_I2S_DMACmd(SPI3, SPI_I2S_DMAReq_Tx, ENABLE);

  // // Enable the IRQ.
  // NVIC_EnableIRQ(DMA1_Stream5_IRQn);
}

void LCD::StartDMARead(uint16_t __bytes) {
  // uint8_t pump = 0;

  // DMA_SetCurrDataCounter(DMA1_Stream5, __bytes);
  // DMA_SetCurrDataCounter(DMA1_Stream0, __bytes);
  // DMA1_Stream5->M0AR = (int)lcd_buffer[0];
  // DMA1_Stream0->M0AR = (int)&pump;
  // DMA_Cmd(DMA1_Stream5, ENABLE);
  // DMA_Cmd(DMA1_Stream0, ENABLE);
  // SPI_I2S_DMACmd(SPI3, SPI_I2S_DMAReq_Tx, ENABLE);
  // SPI_I2S_DMACmd(SPI3, SPI_I2S_DMAReq_Rx, ENABLE);

  // SetFlag(&_EREG_, _RXTC_, FLAG_CLEAR);
  // SetFlag(&_EREG_, _TXTC_, FLAG_CLEAR);
  // SetFlag(&_EREG_, _BUSY_, FLAG_SET);
}

void LCD::StartFrameDMARead(uint32_t * buffer, uint32_t __bytes, uint32_t address) {
  // SetFlag(&_EREG_, _RXTC_, FLAG_CLEAR);
  // SetFlag(&_EREG_, _TXTC_, FLAG_CLEAR);
  // if(GetFlag(&_EREG_, _BUSY_))
    // return;
  // SetFlag(&_EREG_, _BUSY_, FLAG_SET);

  // LOW(LCD_SS);

  // uint8_t send_buf[5];
  // send_buf[0] = READ_66MHZ;
  // send_buf[1] = ((address >> 16) & 0xFF);
  // send_buf[2] = ((address >> 8) & 0xFF);
  // send_buf[3] = ((address) & 0xFF);
  // send_buf[4] = 0x00;

  // Write(send_buf, 5);

  // SPI_I2S_SendData(SPI3, 0);
  // while (!SPI_I2S_GetFlagStatus(SPI3, SPI_I2S_FLAG_TXE));
  // SPI_I2S_ReceiveData(SPI3);
  // while (SPI_I2S_GetFlagStatus(SPI3, SPI_I2S_FLAG_RXNE)) {
  //   SPI_I2S_ReceiveData(SPI3);    
  // }

  // DMA_SetCurrDataCounter(DMA1_Stream5, __bytes);
  // DMA_SetCurrDataCounter(DMA1_Stream0, __bytes);
  // DMA1_Stream0->M0AR = (uint32_t)pump_buffer;
  // DMA1_Stream5->M0AR = (uint32_t)buffer;
  // DMA_Cmd(DMA1_Stream5, ENABLE);
  // DMA_Cmd(DMA1_Stream0, ENABLE);
  // SPI_I2S_DMACmd(SPI3, SPI_I2S_DMAReq_Tx, ENABLE);
  SPI_I2S_DMACmd(SPI3, SPI_I2S_DMAReq_Rx, ENABLE);
}

void LCD::DisplayOn() {

  LOW(LCD_CMD);
  LOW(LCD_SS);

  uint8_t send_buf = 0x28|0x07;

  Write(&send_buf, 1);

  HIGH(LCD_SS);
  HIGH(LCD_CMD);

  system_clock.Delay(1);

  LOW(LCD_CMD);
  LOW(LCD_SS);

  send_buf = 0xAF;

  Write(&send_buf, 1);

  HIGH(LCD_SS);
  HIGH(LCD_CMD);
}

void LCD::Write_Instruction(uint8_t byte) {

  // system_clock.Delay(1);

  LOW(LCD_CMD);

  // LOW(LCD_CLOCK);

  LOW(LCD_SS);

  // __asm__("nop");
  // __asm__("nop");
  // __asm__("nop");
  // __asm__("nop");
  // __asm__("nop");

  Write(&byte, 1);

  while (SPI_I2S_GetFlagStatus(SPI3, SPI_I2S_FLAG_BSY));

  HIGH(LCD_SS);

  // __asm__("nop");
  // __asm__("nop");
  // __asm__("nop");
  // __asm__("nop");
  // __asm__("nop");

  return;
}


void LCD::Write_Data(uint8_t * data, uint32_t size)
{
  HIGH(LCD_CMD);

  // LOW(LCD_CLOCK);

  LOW(LCD_SS);

  // __asm__("nop");
  // __asm__("nop");
  // __asm__("nop");
  // __asm__("nop");
  // __asm__("nop");

  Write(data, size);

  while (SPI_I2S_GetFlagStatus(SPI3, SPI_I2S_FLAG_BSY));

  HIGH(LCD_SS);

  // __asm__("nop");
  // __asm__("nop");
  // __asm__("nop");
  // __asm__("nop");
  // __asm__("nop");

  return;
}

void LCD::Initial() {
  // RESET

  // one cpu frame is 0.000000005952381 = 1 / 168MHz
  // or 5.952381 nanoseconds
  // clock low for min 25ns
  // high for min of 25 ns
  // 25ns = 5 noop
  // one write instruction is (9 * 10 * cpu) 
  // = 0.00000053571429 or 535.71429 ns
  // x 9 instructions = 4 us
  HIGH(LCD_RESET);
  Wait<100>();

  // loading = 30;
  LOW(LCD_RESET);
  Wait<100>();

  // loading = 40;
  HIGH(LCD_RESET);
  Wait<100>();

  Write_Instruction(0xe2);

  // referential c code
  Write_Instruction(0xa2); // set 1/9 bias
  Write_Instruction(0xa0); // seg normal direction
  // Write_Instruction(0xc0); // com reverse direction
  Write_Instruction(0xc8); // com reverse direction

  Write_Instruction(0x20 | 0x4); // regulation ratio 5.0 (0x4)

  Write_Instruction(0x81); // set ev command
  Write_Instruction(0x20); // ev=32

  Write_Instruction(0x2c); // booster on
  Write_Instruction(0x2e); // regulator on
  Write_Instruction(0x2f); // follower on

  // display on?
  loading = 42;


  loading = 43;
  Write_Instruction(0xa6);
  // Write_Instruction(0xa5);
  Write_Instruction(0xaf);

  Display_Picture(pic1);
  loading = 50;
  // // CLEAR ADC
  // Write_Instruction(0xa0);

  // // set shl
  // Write_Instruction(0xc8); // c8 or c0

  // // clear bias
  // Write_Instruction(0xa2);

  // // power control
  // Write_Instruction((0x28|0x07));

  // // regulator resistor select
  // Write_Instruction((0x20|0x05));

  // // set contrast level
  // Write_Instruction(0x81);
  // Write_Instruction(30);

  // // INITIAL LINE
  // Write_Instruction(0x40 | 0x00);

  // // display on
  // Write_Instruction(0xaf);

  // // Write_Instruction(0xa7);   //  Reverse display : 0 illuminated
  // // Write_Instruction(0xa6);   //  Normal display : 1 illuminated
  // // Write_Instruction(0xa5);   //  Entire dislay   Force whole LCD point
  // // Write_Instruction(0xa4); //  Normal display

  // // reverse display off
  // Write_Instruction(0xa6);

  // // entire display off
  // Write_Instruction(0xa4);

  // // display on
  // Write_Instruction(0xaf);

  // Display_Picture(pic);
}

void LCD::Display_Picture(uint8_t pic[])
{
    unsigned char i,j;
  Initial_Dispay_Line(0x40);
  for(i=0;i<0x08;i++)
  {
  Set_Page_Address(i);
    Set_Column_Address(0x00);
        for(j=0;j<0x80;j++)
    {
        Write_Data(&pic[i*0x80+j], 1);
    }
  }
    return;
}

void LCD::Display(uint8_t test[8][128])
{

  // uint8_t a[8][128];
  // memset(a, 0, 128*8);
  // a[4][64] = 255;
  // unsigned char page = 0, column = 0;
  Initial_Dispay_Line(0x40);
  for(unsigned char page = 0; page < 8; page++)
  {
    Set_Page_Address(page);
    Set_Column_Address(0x00);

    // Wait<800>();
    Write_Data(test[page], 128);

    // for(unsigned char column = 0; column < 128; column++)
    // {
    //     // Wait<100>();
    //     // Write_Data(test[page][column], 1);
    // }
  }
  Write_Instruction(0xaf);
    return;
}

void LCD::Initial_Dispay_Line(uint8_t line)
{
    line|=0x40;
    Write_Instruction(line);
  return;
}


// Set page address 0~15
void LCD::Set_Page_Address(uint8_t add)
{
    add=0xb0|add;
    Write_Instruction(add);
  return;
}

void LCD::Set_Column_Address(uint8_t add)
{
    Write_Instruction((0x10|(add>>4)));
  Write_Instruction((0x0f&add));
  return;
}

void LCD::DisplayOff() {

  LOW(LCD_CMD);
  LOW(LCD_SS);

  uint8_t send_buf = 0x28|0x07;

  Write(&send_buf, 1);

  HIGH(LCD_SS);
  HIGH(LCD_CMD);

  system_clock.Delay(1);

  LOW(LCD_CMD);
  LOW(LCD_SS);

  send_buf = 0xAE;

  Write(&send_buf, 1);

  HIGH(LCD_SS);
  HIGH(LCD_CMD);
}



void LCD::Draw() {
  Write_Instruction(0xB0);

  system_clock.Delay(1);

  HIGH(LCD_CMD);
  LOW(LCD_SS);

  for(int i = 0; i < 128; i++) {
    uint8_t send_buf = 0xff;

    Write(&send_buf, 1);
  }
  HIGH(LCD_SS);
}

void LCD::StartDMAWrite() {

  if(page_ == 0) {
    Initial_Dispay_Line(0x40);
  }

  Set_Page_Address(page_);
  Set_Column_Address(0x00);

  DMA_SetCurrDataCounter(DMA1_Stream5, 128);
  DMA1_Stream5->M0AR = (int)(Display::framebuffer[page_]);
  DMA_Cmd(DMA1_Stream5, ENABLE);
  SPI_I2S_DMACmd(SPI3, SPI_I2S_DMAReq_Tx, ENABLE);

  // SetFlag(&_EREG_, _RXTC_, FLAG_CLEAR);
  // SetFlag(&_EREG_, _TXTC_, FLAG_CLEAR);
  // SetFlag(&_EREG_, _BUSY_, FLAG_SET);
}

void LCD::StopDMA() {
  loading = 2;
  DMA_ClearFlag(DMA1_Stream5, DMA_FLAG_TCIF5 | DMA_FLAG_HTIF5);
  // DMA_ClearFlag(DMA1_Stream0, DMA_FLAG_TCIF0 | DMA_FLAG_HTIF0);

  // while (!SPI_I2S_GetFlagStatus(SPI3, SPI_I2S_FLAG_TXE));
  // while (SPI_I2S_GetFlagStatus(SPI3, SPI_I2S_FLAG_RXNE));
    // while (SPI_I2S_GetFlagStatus(SPI3, SPI_I2S_FLAG_RXNE)) {
    // SPI_I2S_ReceiveData(SPI3);    
  // }

  DMA_Cmd(DMA1_Stream5, DISABLE);
  // DMA_Cmd(DMA1_Stream0, DISABLE);
  SPI_I2S_DMACmd(SPI3, SPI_I2S_DMAReq_Tx, DISABLE);
  // SPI_I2S_DMACmd(SPI3, SPI_I2S_DMAReq_Rx, DISABLE);

  HIGH(LCD_SS);

  // SetFlag(&_EREG_, _RXNE_, FLAG_SET);
}

}  // namespace waves


extern "C" {

// Rx Transfer complete
// void DMA1_Stream0_IRQHandler(void) {
//     loading = 1;
//   if(DMA_GetFlagStatus(DMA1_Stream0, DMA_FLAG_TCIF0)) {
//     DMA_ClearFlag(DMA1_Stream0, DMA_FLAG_TCIF0 | DMA_FLAG_HTIF0);

//     SetFlag(&_EREG_, _RXTC_, FLAG_SET);

//     // if(GetFlag(&_EREG_, _TXTC_)) {
//       waves::LCD::GetInstance()->StopDMA();
//     // }
//   }
// }

// Tx Transfer complete
void DMA1_Stream5_IRQHandler(void) {
  // loading++;
  if(DMA_GetFlagStatus(DMA1_Stream5, DMA_FLAG_TCIF5)) {
    DMA_ClearFlag(DMA1_Stream5, DMA_FLAG_TCIF5 | DMA_FLAG_HTIF5);

    waves::LCD::GetInstance()->increment_page();
    if(waves::LCD::GetInstance()->get_page() < 8) {
      waves::LCD::GetInstance()->StopDMA();
      waves::LCD::GetInstance()->StartDMAWrite();
    } else {
      waves::LCD::GetInstance()->set_page(0);
      waves::LCD::GetInstance()->StopDMA();
      waves::LCD::GetInstance()->Write_Instruction(0xaf);
    }
    // SetFlag(&_EREG_, _TXTC_, FLAG_SET);

    // if(GetFlag(&_EREG_, _RXTC_)) {
      // waves::LCD::GetInstance()->StopDMA();
    // }
  }
}

  
}
